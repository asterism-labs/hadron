## Kconfig
```kconfig
# Hadron kernel root configuration.
#
# Distributed Kconfig files are sourced from subdirectories
# near the code they affect.

source "kernel/kernel/Kconfig"
source "kernel/drivers/Kconfig"
```

## kernel/hadron-drivers/Kconfig
```kconfig
# Hadron driver configuration.

menu "Storage Drivers"

config driver_ahci
    bool "AHCI SATA storage controller"
    default y
    depends on pci
    binding cfg

endmenu

menu "Network Drivers"

config driver_e1000e
    bool "Intel PRO/1000 PCIe (e1000e) Ethernet"
    default y
    depends on pci
    binding cfg

endmenu

menu "Display Drivers"

config driver_bochs_vga
    bool "Bochs/QEMU VGA display"
    default y
    depends on pci
    binding cfg

endmenu

menu "Input Drivers"

config driver_i8042
    bool "PS/2 (i8042) keyboard and mouse controller"
    default y
    binding cfg

endmenu

menu "Virtualization Drivers"

config driver_virtio
    bool "VirtIO devices (block, GPU, network)"
    default y
    depends on pci
    binding cfg

endmenu

menu "Filesystem Drivers"

config driver_fs_fat
    bool "FAT filesystem"
    default y
    binding cfg

config driver_fs_iso9660
    bool "ISO 9660 filesystem (CD-ROM)"
    default y
    binding cfg

config driver_fs_ramfs
    bool "RAM filesystem"
    default y
    binding cfg

config driver_fs_initramfs
    bool "Initial ramdisk filesystem (initramfs)"
    default y
    binding cfg

endmenu
```

## kernel/hadron-kernel/Kconfig
```kconfig
# Hadron kernel core configuration.

menu "General"

config serial_log
    bool "Enable serial port logging"
    default y
    binding cfg

config LOG_LEVEL
    choice "Kernel log level" [error, warn, info, debug, trace]
    default "debug"
    binding cfg cumulative
    binding const

config KERNEL_HEAP_SIZE
    u64 "Kernel heap size in bytes"
    default 0x100000
    binding const

endmenu

menu "SMP"

config smp
    bool "Enable symmetric multiprocessing"
    default y
    depends on acpi
    select apic
    binding cfg
    binding build

config MAX_CPUS
    u32 "Maximum number of CPUs supported"
    default 256
    range 1 256
    depends on smp
    binding const

endmenu

menu "Hardware"

config acpi
    bool "Enable ACPI table parsing"
    default y
    binding cfg

config apic
    bool "Enable APIC interrupt controller"
    default n
    binding cfg

endmenu

menu "Debugging"

config lock_debug
    bool "IRQ-context spinlock assertion"
    default y
    binding cfg

config lockdep
    bool "Lock dependency tracking"
    default y
    binding cfg

config lockdep_warn
    bool "Lockdep warn-only mode (log violations, do not panic)"
    default y
    depends on lockdep
    binding cfg

config no_work_steal
    bool "Disable work stealing (debug)"
    default n
    depends on smp
    binding cfg

config lock_stress
    bool "Lock contention stress delays"
    default n
    depends on lockdep
    binding cfg
    help "Inject random spin delays around lock acquire/release to surface race conditions"

config LOCK_STRESS_MAX_US
    u32 "Maximum stress delay (microseconds)"
    default 10
    range 1 100
    depends on lock_stress
    binding const

config lock_stat
    bool "Lock contention statistics"
    default n
    depends on lockdep
    binding cfg

menu "Subsystem Tracing"

config trace_mm
    bool "Memory management tracing (PMM, VMM, heap)"
    default n
    binding cfg

config trace_vfs
    bool "VFS tracing"
    default n
    binding cfg

config trace_sched
    bool "Scheduler tracing"
    default n
    binding cfg

config trace_pci
    bool "PCI bus tracing"
    default n
    binding cfg

config trace_acpi
    bool "ACPI tracing"
    default n
    binding cfg

config trace_irq
    bool "Interrupt tracing"
    default n
    binding cfg

config trace_syscall
    bool "Syscall tracing"
    default n
    binding cfg

config trace_drivers
    bool "Driver framework tracing"
    default n
    binding cfg

endmenu

menu "Sanitizers"

config debug_heap_poison
    bool "Heap allocation poisoning & red zones"
    default n
    binding cfg
    help "Fill allocations with 0xCD, freed memory with 0xDD, add 16-byte red zones (0xFD)"

config debug_pmm_poison
    bool "Physical page poisoning"
    default n
    binding cfg
    help "Fill freed pages with 0xDEAD pattern, verify on allocation (detects use-after-free)"

config debug_alloc_track
    bool "Allocation origin tracking"
    default n
    depends on debug_heap_poison
    binding cfg
    help "Track allocation counts and origins, provides dump_alloc_stats() for leak investigation"

endmenu

menu "Profiling"

config profile_sample
    bool "Sampling profiler"
    default n
    depends on acpi
    binding cfg

config PROFILE_SAMPLE_RATE
    u32 "Sample rate (Hz, max 1000)"
    default 100
    range 1 1000
    depends on profile_sample
    binding const

config PROFILE_SAMPLE_DEPTH
    u32 "Max stack depth per sample"
    default 16
    range 1 64
    depends on profile_sample
    binding const

config PROFILE_SAMPLE_BUFFER
    u32 "Per-CPU sample buffer entries"
    default 1024
    range 128 16384
    depends on profile_sample
    binding const

config profile_ftrace
    bool "Function tracing (mcount)"
    default n
    binding cfg
    binding build

config PROFILE_FTRACE_BUFFER_KB
    u32 "Per-CPU ftrace buffer (KB)"
    default 64
    range 16 1024
    depends on profile_ftrace
    binding const

config PROFILE_DURATION_SECS
    u32 "Profiling duration (seconds)"
    default 10
    range 1 300
    depends on profile_sample || profile_ftrace
    binding const

endmenu

endmenu
```
