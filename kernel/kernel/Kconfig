## kernel/kernel/Kconfig
```kconfig
menu "Kernel"

config KERNEL_DEBUG
    bool "Enable kernel debug output"
    default y

endmenu

menu "Logging"

config LOG_MAX_LEVEL
    u32 "Maximum log level (0=fatal only, 255=all)"
    default 255

endmenu

menu "Platform"

config ACPI
    bool "ACPI table parsing and platform init"
    default y

config APIC
    bool "Local APIC and I/O APIC support"
    default y
    depends on ACPI

config HPET
    bool "HPET timer support"
    default y
    depends on ACPI

config SMP
    bool "Enable SMP (multi-core support)"
    default y
    depends on APIC

config IOMMU
    bool "IOMMU (Intel VT-d) support"
    default y
    depends on ACPI

endmenu

menu "CPU Features"

config ALT_INSTRUCTIONS
    bool "Boot-time instruction patching"
    default y

config KERNEL_FPU
    bool "Kernel FPU/SSE/AVX state management"
    default y

endmenu

preset debug
    set KERNEL_DEBUG y
    set ACPI y
    set APIC y
    set HPET y
    set ALT_INSTRUCTIONS y
    set KERNEL_FPU y
    set SMP y
    set IOMMU y

preset release
    set KERNEL_DEBUG n
    set ACPI y
    set APIC y
    set HPET y
    set ALT_INSTRUCTIONS y
    set KERNEL_FPU y
    set SMP y
    set IOMMU y
```
